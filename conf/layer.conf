## conf/layer.conf
```bitbake
# We have a conf and classes directory, add to BBPATH
BBPATH .= ":${LAYERDIR}"

# We have recipes-* directories, add to BBFILES
BBFILES += "${LAYERDIR}/recipes-*/*/*.bb ${LAYERDIR}/recipes-*/*/*.bbappend"

BBFILE_COLLECTIONS += "bluepy"
BBFILE_PATTERN_bluepy = "^${LAYERDIR}/"
BBFILE_PRIORITY_bluepy = "1"

# This should only be incremented on significant changes that will
# cause compatibility issues with other layers
LAYERVERSION_bluepy = "1"

LAYERDEPENDS_bluepy = "core"
```
